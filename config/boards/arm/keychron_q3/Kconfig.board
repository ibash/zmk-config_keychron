## config/boards/arm/keychron_q3/Kconfig.board
```kconfig
# Copyright (c) 2022-2023 XiNGRZ
# SPDX-License-Identifier: MIT

config BOARD_KEYCHRON_Q3
	bool "Keychron Q3"
	depends on SOC_STM32L432XX
```

## config/boards/arm/keychron_q3/Kconfig.defconfig
```kconfig
# Copyright (c) 2022-2023 XiNGRZ
# SPDX-License-Identifier: MIT

if BOARD_KEYCHRON_Q3

config BOARD
	default "keychron_q3"

config ZMK_KEYBOARD_NAME
	default "Keychron Q3"

config ZMK_USB
	default y

choice ZMK_HID_REPORT_TYPE
	default ZMK_HID_REPORT_TYPE_NKRO
endchoice

endif # BOARD_KEYCHRON_Q3
```
